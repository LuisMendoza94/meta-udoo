## conf/layer.conf
```bitbake
# We have a conf and classes directory, add to BBPATH
BBPATH .= ":${LAYERDIR}"

# We have recipes-* directories, add to BBFILES
BBFILES += "${LAYERDIR}/recipes-*/*/*.bb ${LAYERDIR}/recipes-*/*/*.bbappend"

BBFILE_COLLECTIONS += "udoo"
BBFILE_PATTERN_udoo = "^${LAYERDIR}/"
BBFILE_PRIORITY_udoo = "10"

# This should only be incremented on significant changes that will
# cause compatibility issues with other layers
LAYERVERSION_udoo-ml = "1"

LAYERDEPENDS_udoo = "core"

LAYERSERIES_COMPAT_udoo = "dunfell"
```

## conf/machine/udooneo.conf
```bitbake
#imx6sx is based on cortex a9 architecture
include conf/machine/include/tune-cortexa9.inc

#define kernel for udoo boards
PREFERRED_PROVIDER_virtual/kernel ?= "linux-yocto-udoo"
KERNEL_IMAGETYPE = "zImage"

#define device tree required for boards
KERNEL_DEVICETREE ?= "\
		imx6sx-udoo-neo-basic.dtb \
		imx6sx-udoo-neo-extended.dtb \
		imx6sx-udoo-neo-full.dtb \
		"

#enable serial console
SERIAL_CONSOLES = "115200;ttymxc0"

#define uboot environment
UBOOT_CONFIG ??= "sd"
UBOOT_CONFIG[sd] = "udoo_neo_config"
UBOOT_SUFFIX = "img"
SPL_BINARY = "SPL"

#define wic image parameters
do_image_wic[depends] += "virtual/bootloader:do_populate_sysroot"
WKS_FILE = "udoo-neo-sdcard.wks" 
IMAGE_FSTYPES_append = " wic.bz2"

IMAGE_BOOT_FILES = "${KERNEL_IMAGETYPE} ${KERNEL_DEVICETREE} boot.scr"

#define machine-dependant packages to be installed in rootfs
MACHINE_ESSENTIAL_EXTRA_RRECOMMENDS += "u-boot-bootscript kernel-modules kernel-devicetree linux-firmware-wl18xx linux-firmware-imx-sdma-imx6q wl18xx-conf bt-firmware libgpiod"

MACHINE_EXTRA_RRECOMMENDS_append = "libdrm-etnaviv"

#define machine features
MACHINE_FEATURES += " usbhost usbgadget bluetooth wifi"
```
